## boards/cirrus/crd40l50/Kconfig.crd40l50
```kconfig
# Copyright (c) 2025 Cirrus Logic, Inc.
# SPDX-License-Identifier: Apache-2.0

# Required to select STM32F401XE instead of STM32F401XD because the STM32 HAL
# does not provide a define for STM32F401xD variants. Because STM32F401xD and
# STM32F401xE microcontrollers are identical apart from the size of embedded
# flash memory, we select SOC_STM32F401XE and then update the size of the SoC
# flash memory from 512 kB to 384 kB in the devicetree.

config BOARD_CRD40L50
	select SOC_STM32F401XE
```

## boards/cirrus/crd40l50/crd40l50_defconfig
```kconfig
# Copyright (c) 2025 Cirrus Logic, Inc.
# SPDX-License-Identifier: Apache-2.0

# Required for use of board peripherals
CONFIG_FLASH=y
CONFIG_GPIO=y
CONFIG_HAPTICS=y

# Required to flash and debug with the SEGGER J-Link
CONFIG_SERIAL=y
CONFIG_CONSOLE=y
CONFIG_RTT_CONSOLE=y
CONFIG_UART_RTT=y
CONFIG_USE_SEGGER_RTT=y

# Required to use shell interface with the SEGGER J-Link
CONFIG_SHELL_BACKEND_RTT=y
```

## drivers/haptics/cirrus/Kconfig.cirrus
```kconfig
# Copyright 2026 Cirrus Logic, Inc.
# SPDX-License-Identifier: Apache-2.0

config HAPTICS_CIRRUS
	def_bool DT_HAS_CIRRUS_CS40L26_ENABLED || \
		 DT_HAS_CIRRUS_CS40L27_ENABLED || \
		 DT_HAS_CIRRUS_CS40L50_ENABLED || \
		 DT_HAS_CIRRUS_CS40L51_ENABLED || \
		 DT_HAS_CIRRUS_CS40L52_ENABLED || \
		 DT_HAS_CIRRUS_CS40L53_ENABLED

if HAPTICS_CIRRUS

config HAPTICS_CIRRUS_I2C
	def_bool $(dt_compat_on_bus,$(DT_COMPAT_CIRRUS_CS40L26),i2c) || \
		 $(dt_compat_on_bus,$(DT_COMPAT_CIRRUS_CS40L27),i2c) || \
		 $(dt_compat_on_bus,$(DT_COMPAT_CIRRUS_CS40L50),i2c) || \
		 $(dt_compat_on_bus,$(DT_COMPAT_CIRRUS_CS40L51),i2c) || \
		 $(dt_compat_on_bus,$(DT_COMPAT_CIRRUS_CS40L52),i2c) || \
		 $(dt_compat_on_bus,$(DT_COMPAT_CIRRUS_CS40L53),i2c)
	select I2C

config HAPTICS_CIRRUS_SPI
	def_bool $(dt_compat_on_bus,$(DT_COMPAT_CIRRUS_CS40L26),spi) || \
		 $(dt_compat_on_bus,$(DT_COMPAT_CIRRUS_CS40L27),spi) || \
		 $(dt_compat_on_bus,$(DT_COMPAT_CIRRUS_CS40L50),spi) || \
		 $(dt_compat_on_bus,$(DT_COMPAT_CIRRUS_CS40L51),spi) || \
		 $(dt_compat_on_bus,$(DT_COMPAT_CIRRUS_CS40L52),spi) || \
		 $(dt_compat_on_bus,$(DT_COMPAT_CIRRUS_CS40L53),spi)
	select SPI

config HAPTICS_CIRRUS_RESET
	def_bool $(dt_compat_any_has_prop,$(DT_COMPAT_CIRRUS_CS40L26),reset-gpios) || \
		 $(dt_compat_any_has_prop,$(DT_COMPAT_CIRRUS_CS40L27),reset-gpios) || \
		 $(dt_compat_any_has_prop,$(DT_COMPAT_CIRRUS_CS40L50),reset-gpios) || \
		 $(dt_compat_any_has_prop,$(DT_COMPAT_CIRRUS_CS40L51),reset-gpios) || \
		 $(dt_compat_any_has_prop,$(DT_COMPAT_CIRRUS_CS40L52),reset-gpios) || \
		 $(dt_compat_any_has_prop,$(DT_COMPAT_CIRRUS_CS40L53),reset-gpios)

config HAPTICS_CIRRUS_INTERRUPT
	def_bool $(dt_compat_any_has_prop,$(DT_COMPAT_CIRRUS_CS40L26),int-gpios) || \
		 $(dt_compat_any_has_prop,$(DT_COMPAT_CIRRUS_CS40L27),int-gpios) || \
		 $(dt_compat_any_has_prop,$(DT_COMPAT_CIRRUS_CS40L50),int-gpios) || \
		 $(dt_compat_any_has_prop,$(DT_COMPAT_CIRRUS_CS40L51),int-gpios) || \
		 $(dt_compat_any_has_prop,$(DT_COMPAT_CIRRUS_CS40L52),int-gpios) || \
		 $(dt_compat_any_has_prop,$(DT_COMPAT_CIRRUS_CS40L53),int-gpios)

config HAPTICS_CIRRUS_TRIGGER
	def_bool $(dt_compat_any_has_prop,$(DT_COMPAT_CIRRUS_CS40L26),trigger-gpios) || \
		 $(dt_compat_any_has_prop,$(DT_COMPAT_CIRRUS_CS40L27),trigger-gpios) || \
		 $(dt_compat_any_has_prop,$(DT_COMPAT_CIRRUS_CS40L50),trigger-gpios) || \
		 $(dt_compat_any_has_prop,$(DT_COMPAT_CIRRUS_CS40L51),trigger-gpios) || \
		 $(dt_compat_any_has_prop,$(DT_COMPAT_CIRRUS_CS40L52),trigger-gpios) || \
		 $(dt_compat_any_has_prop,$(DT_COMPAT_CIRRUS_CS40L53),trigger-gpios)

config HAPTICS_CIRRUS_FLASH
	def_bool $(dt_compat_any_has_prop,$(DT_COMPAT_CIRRUS_CS40L26),flash-storage) || \
		 $(dt_compat_any_has_prop,$(DT_COMPAT_CIRRUS_CS40L27),flash-storage) || \
		 $(dt_compat_any_has_prop,$(DT_COMPAT_CIRRUS_CS40L50),flash-storage) || \
		 $(dt_compat_any_has_prop,$(DT_COMPAT_CIRRUS_CS40L51),flash-storage) || \
		 $(dt_compat_any_has_prop,$(DT_COMPAT_CIRRUS_CS40L52),flash-storage) || \
		 $(dt_compat_any_has_prop,$(DT_COMPAT_CIRRUS_CS40L53),flash-storage)
	select FLASH

config HAPTICS_CIRRUS_CALIBRATION
	bool "Calibration"
	default y
	help
	  Enables calibration routine and optionally writes calibration data to flash memory if
	  flash storage is provided.

config HAPTICS_CIRRUS_CLICK_COMPENSATION
	bool "Click compensation"
	default y
	help
	  If enabled, the device uses calibrated F0 and ReDC values to adjust the amplitude and
	  time scale of the reference waveform to compensate for variations in LRAs. Calibration
	  data is required for click compensation to be effective.

config HAPTICS_CIRRUS_DYNAMIC_F0
	bool "Dynamic F0 compensation"
	default y
	help
	  If enabled, the device estimates F0 during playback for haptic effects on a
	  waveform-by-waveform basis and adjusts subsequent playback events to improve F0 accuracy.

config HAPTICS_CIRRUS_DEBOUNCE_US
	int "Interrupt debounce threshold in microseconds"
	default 500
	range 0 10000
	help
	  Specifies the delay in microseconds when scheduling a worker to handle a GPIO callback
	  event.

config HAPTICS_CIRRUS_POLLING_INTERVAL_US
	int "Interval for polling registers in microseconds"
	default 1000
	range 0 1000000
	help
	  Specifies the delay in microseconds between reading hardware registers when polling for
	  an expected value.

config HAPTICS_CIRRUS_TIMEOUT_MS
	int "Timeout threshold for API calls in milliseconds"
	default 1000
	range 0 10000
	help
	  Specifies the timeout in milliseconds that an API function call will wait for a mutex
	  lock before erroring out.

endif #HAPTICS_CIRRUS
```

## drivers/haptics/cirrus/Kconfig.cs40l26
```kconfig
# Copyright 2026 Cirrus Logic, Inc.
# SPDX-License-Identifier: Apache-2.0

menuconfig HAPTICS_CS40L26
	bool "CS40L26/27 Haptics Driver"
	default y
	depends on DT_HAS_CIRRUS_CS40L26_ENABLED || \
		   DT_HAS_CIRRUS_CS40L27_ENABLED
	help
	  Enable CS40L26/27 haptics driver.

if HAPTICS_CS40L26

config HAPTICS_CS40L26_A1
	def_bool $(dt_compat_on_bus,$(DT_COMPAT_CIRRUS_CS40L26),i2c) || \
		 $(dt_compat_on_bus,$(DT_COMPAT_CIRRUS_CS40L26),spi)

config HAPTICS_CS40L27_B2
	def_bool $(dt_compat_on_bus,$(DT_COMPAT_CIRRUS_CS40L27),i2c) || \
		 $(dt_compat_on_bus,$(DT_COMPAT_CIRRUS_CS40L27),spi)

config HAPTICS_CS40L26_PM_ACTIVE_TIMEOUT
	int "Active Timeout"
	default 0
	range 0 327680
	help
	  After the device has finished playing an effect, wait the specified amount
	  of time (in units of 1/32768 seconds) before entering the standby state.

config HAPTICS_CS40L26_PM_STDBY_TIMEOUT
	int "Standby Timeout"
	default 32768
	range 0 327680
	help
	  When the device enters the standby state with hibernation enabled, wait the
	  specified amount of time (in units of 1/32768 seconds) before entering hibernation.

endif #HAPTICS_CS40L26
```

## drivers/haptics/cirrus/Kconfig.cs40l5x
```kconfig
# Copyright 2025 Cirrus Logic, Inc.
# SPDX-License-Identifier: Apache-2.0

menuconfig HAPTICS_CS40L5X
	bool "CS40L5x Haptics Driver"
	default y
	depends on DT_HAS_CIRRUS_CS40L50_ENABLED || \
		   DT_HAS_CIRRUS_CS40L51_ENABLED || \
		   DT_HAS_CIRRUS_CS40L52_ENABLED || \
		   DT_HAS_CIRRUS_CS40L53_ENABLED
	help
	  Enable CS40L5x haptics driver.

if HAPTICS_CS40L5X

config HAPTICS_CS40L5X_EXTERNAL_BOOST
	def_bool $(dt_compat_any_has_prop,$(DT_COMPAT_CIRRUS_CS40L50),external-boost) || \
		 $(dt_compat_any_has_prop,$(DT_COMPAT_CIRRUS_CS40L51),external-boost) || \
		 $(dt_compat_any_has_prop,$(DT_COMPAT_CIRRUS_CS40L52),external-boost) || \
		 $(dt_compat_any_has_prop,$(DT_COMPAT_CIRRUS_CS40L53),external-boost)

config HAPTICS_CS40L5X_CUSTOM_EFFECTS
	bool "Custom Haptics Sources (PCM/PWLE)"
	default y
	help
	  Enable upload and playback of custom PCM and PWLE waveforms.

config HAPTICS_CS40L5X_DSP_LOGGER
	bool "DSP Logging"
	default y
	help
	  Enable runtime configuration of the DSP logger, which can
	  report back EMF, voltage, and voltage boost information.

config HAPTICS_CS40L5X_PM_ACTIVE_TIMEOUT
	int "Active Timeout"
	default 0
	range 0 327680
	help
	  After the device has finished playing an effect, wait the specified amount
	  of time (in units of 1/32768 seconds) before entering the standby state.

config HAPTICS_CS40L5X_PM_STDBY_TIMEOUT
	int "Standby Timeout"
	default 32768
	range 0 327680
	help
	  When the device enters the standby state with hibernation enabled, wait the
	  specified amount of time (in units of 1/32768 seconds) before entering hibernation.

endif #HAPTICS_CS40L5X
```

## dts/bindings/haptics/cirrus,cs40l26-base.yaml
```yaml
# Copyright (c) 2026 Cirrus Logic, Inc.
# SPDX-License-Identifier: Apache-2.0

description: CS40L26/27 haptic driver

include: "cirrus,cs40lxx-base.yaml"
```

## dts/bindings/haptics/cirrus,cs40l51-i2c.yaml
```yaml
# Copyright (c) 2026 Cirrus Logic, Inc.
# SPDX-License-Identifier: Apache-2.0

description: I2C-based CS40L51 Haptic Driver

compatible: "cirrus,cs40l51"

on-bus: i2c

include: ["i2c-device.yaml", "cirrus,cs40l5x-base.yaml"]
```

## dts/bindings/haptics/cirrus,cs40l53-i2c.yaml
```yaml
# Copyright (c) 2026 Cirrus Logic, Inc.
# SPDX-License-Identifier: Apache-2.0

description: I2C-based CS40L53 Haptic Driver

compatible: "cirrus,cs40l53"

on-bus: i2c

include: ["i2c-device.yaml", "cirrus,cs40l5x-base.yaml"]
```

## dts/bindings/haptics/cirrus,cs40l5x-base.yaml
```yaml
# Copyright (c) 2025 Cirrus Logic, Inc.
# SPDX-License-Identifier: Apache-2.0

description: CS40L5x haptic driver

include: "cirrus,cs40lxx-base.yaml"

properties:
  external-boost:
    type: phandle
    description: External boost source. Must be a phandle to a regulator.
```

## dts/bindings/haptics/cirrus,cs40lxx-base.yaml
```yaml
# Copyright (c) 2026 Cirrus Logic, Inc.
# SPDX-License-Identifier: Apache-2.0

description: Common properties shared by Cirrus Logic haptic drivers

properties:
  reset-gpios:
    type: phandle-array
    description: Output pin mapped to the device's reset pin.

  int-gpios:
    type: phandle-array
    description: Input pin mapped to the device's interrupt pin.

  trigger-gpios:
    type: phandle-array
    description: Output pins mapped to the device's trigger pins.

  trigger-mapping:
    type: array
    description: |
      For each output pin provided to 'trigger-gpios', provide the corresponding device pin number.

  flash-storage:
    type: phandle
    description: |
      Flash storage for device data. Must be a phandle to a flash device or fixed partition.

  flash-offset:
    type: int
    description: Flash byte offset to store and load data.
```

## samples/drivers/haptics/cs40l26/sample.yaml
```yaml
sample:
  name: Cirrus Logic CS40L26/27 haptic driver sample
tests:
  sample.drivers.haptics.cs40l26:
    build_only: true
    tags: haptics
    platform_allow:
      - nucleo_f401re
```
